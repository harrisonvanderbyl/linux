## Documentation/devicetree/bindings/media/i2c/ovti,ov13858.yaml
```yaml
# SPDX-License-Identifier: (GPL-2.0-only OR BSD-2-Clause)
# Copyright (c) 2017 Intel Corporation
%YAML 1.2
---
$id: http://devicetree.org/schemas/media/i2c/ovti,ov13858.yaml#
$schema: http://devicetree.org/meta-schemas/core.yaml#

title: OmniVision OV13858 CMOS Image Sensor

maintainers:
  - Chris Kan <chris.kan@intel.com>

description: |
  The OmniVision OV13858 is a 1/3.06-inch high resolution CMOS active pixel
  digital image sensor with a maximum active array size of 4224x3136 (13MP).
  It is programmable through an I2C interface. Image data is streamed over
  a 4-lane MIPI CSI-2 interface and supports 10-bit Bayer (GRBG) output at
  link frequencies of 270 MHz and 540 MHz.

allOf:
  - $ref: /schemas/i2c/i2c-controller.yaml#

properties:
  compatible:
    const: ovti,ov13858

  reg:
    maxItems: 1

  clocks:
    description:
      Input reference clock (XVCLK). Must be 19.2 MHz.
    maxItems: 1

  reset-gpios:
    description:
      Reference to the GPIO connected to the XSHUTDN pin of the sensor.
      This pin is physically active low.
    maxItems: 1

  dovdd-supply:
    description: Digital I/O power supply (typ. 1.8 V).

  avdd-supply:
    description: Analog power supply (typ. 2.8 V).

  dvdd-supply:
    description: Digital core power supply (typ. 1.2 V).

  port:
    $ref: /schemas/graph.yaml#/$defs/port-base
    additionalProperties: false
    description:
      Output port for the MIPI CSI-2 interface.

    properties:
      endpoint:
        $ref: /schemas/media/video-interfaces.yaml#
        unevaluatedProperties: false

        properties:
          data-lanes:
            items:
              - const: 1
              - const: 2
              - const: 3
              - const: 4

          link-frequencies:
            $ref: /schemas/types.yaml#/definitions/uint64-array
            description:
              Allowed values are 270000000 and 540000000.
            items:
              enum: [ 270000000, 540000000 ]

        required:
          - data-lanes
          - link-frequencies

required:
  - compatible
  - reg
  - clocks
  - port

unevaluatedProperties: false

examples:
  - |
    #include <dt-bindings/gpio/gpio.h>

    i2c {
        #address-cells = <1>;
        #size-cells = <0>;

        camera@10 {
            compatible = "ovti,ov13858";
            reg = <0x10>;

            clocks = <&osc 0>;
            reset-gpios = <&gpio1 3 GPIO_ACTIVE_LOW>;

            dovdd-supply = <&vcc_1v8>;
            avdd-supply = <&vcc_2v8>;
            dvdd-supply = <&vcc_1v2>;

            port {
                ov13858_ep: endpoint {
                    remote-endpoint = <&csi2_in>;
                    data-lanes = <1 2 3 4>;
                    link-frequencies = /bits/ 64 <270000000 540000000>;
                };
            };
        };
    };
...
```
